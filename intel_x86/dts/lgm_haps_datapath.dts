// SPDX-License-Identifier: GPL-2.0
/*
 * Copyright (C) 2020-2025 MaxLinear, Inc.
 * Copyright (c) 2018-2020 Intel Corporation.
 */

/dts-v1/;
#include "lgm_haps_datapath_base.dtsi"

#include "config_ddr_2gb.dtsi"
#include "config_subsystem_gw.dtsi"
#include "config_wave6x4.dtsi"
#include "bm_main_eth.dtsi"
