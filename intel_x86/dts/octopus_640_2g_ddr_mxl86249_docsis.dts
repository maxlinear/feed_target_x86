// SPDX-License-Identifier: GPL-2.0
/*
 * Copyright (C) 2024-2025 MaxLinear, Inc.
 */

/dts-v1/;
#include "octopus_640_base.dtsi"
#include "octopus_640_docsis.dtsi"
#include "octopus_640_p34x_lan.dtsi"
#include "octopus_emmc.dtsi"
#include "octopus_640_led.dtsi"
#include "octopus_640_gpy215.dtsi"
#include "octopus_640_gsw120.dtsi"
#include "voice.dtsi"

#include "config_ddr_2gb.dtsi"
#include "config_subsystem_gw.dtsi"
#include "config_wave700.dtsi"
#include "bm_main_docsis.dtsi"
