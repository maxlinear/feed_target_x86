
// SPDX-License-Identifier: GPL-2.0
/*
 * Copyright (C) 2021-2025 MaxLinear, Inc.
 */
/dts-v1/;
#include <dt-bindings/thermal/thermal.h>

#include "lgp.dtsi"
#include "lgp_thermal_no_fan_big_heatsink.dtsi"
#include "voice.dtsi"
#include "lgp_b0.dtsi"
#include "lgm_pon.dtsi"

#include "config_ddr_2gb.dtsi"
#include "config_subsystem_gw.dtsi"
#include "config_wave700.dtsi"
#include "bm_main_pon.dtsi"
