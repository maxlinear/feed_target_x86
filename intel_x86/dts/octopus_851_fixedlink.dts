// SPDX-License-Identifier: GPL-2.0
/*
 * Copyright (C) 2020-2025 MaxLinear, Inc.
 * Copyright (C) 2019-2020 Intel Corporation.
 */

/dts-v1/;
#include "octopus_851_base.dtsi"
#include "octopus_sfp_eth_wan_fixedlink.dtsi"
#include "octopus_641_pcie20.dtsi"
#include "octopus_emmc.dtsi"
#include "octopus_641_led.dtsi"
#include "voice.dtsi"

#include "config_ddr_2gb.dtsi"
#include "config_subsystem_gw.dtsi"
#include "config_wave6x4.dtsi"
#include "bm_main_eth.dtsi"
