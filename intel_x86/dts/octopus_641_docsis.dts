// SPDX-License-Identifier: GPL-2.0
/*
 * Copyright (C) 2023 MaxLinear, Inc.
 */

/dts-v1/;
#include "octopus_641_base.dtsi"
#include "octopus_641_pcie20.dtsi"
#include "octopus_641_docsis.dtsi"
#include "octopus_emmc.dtsi"
#include "octopus_641_docsis_led.dtsi"
#include "voice.dtsi"

#include "config_ddr_2gb.dtsi"
#include "config_subsystem_gw.dtsi"
#include "config_wave700.dtsi"
#include "bm_main_docsis.dtsi"
