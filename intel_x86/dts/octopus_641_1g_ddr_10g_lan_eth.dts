/dts-v1/;
#include "octopus_641_base.dtsi"
#include "octopus_641_sfp_eth_wan.dtsi"
#include "octopus_641_10g_phy_lan.dtsi"
#include "octopus_emmc.dtsi"
#include "octopus_641_led.dtsi"
#include "voice.dtsi"

#include "config_ddr_1gb.dtsi"
#include "config_subsystem_gw.dtsi"
#include "config_wave6x4.dtsi"
#include "bm_main_eth.dtsi"

