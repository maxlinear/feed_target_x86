## intel_x86/image/Config.in
```kconfig
config X86_ETHERBOOT_IMAGES
	bool "Build Etherboot image"
	depends on TARGET_x86_thincan_DBE61
	default y
	help
		Builds network bootable image for ThinCan DBE61 (Etherboot BIOS)

config X86_ETHERBOOT_BOOTOPTS
	string "Extra kernel boot options"
	depends on X86_ETHERBOOT_IMAGES
	default "ip=dhcp nbdport=2000 " if TARGET_ROOTFS_SQUASHFS
	default "ip=dhcp root=/dev/nfs nfsroot=192.168.0.1:/srv/dbe61"
	help
		Kernel arguments to pass to the kernel eg. NFS root location etc.

config NEW_FRAMEWORK
	bool "UGW NEW FRAMEWORK"
	default y
	help
		UGW New Framework

config INTEL_X86_ALT_SUBTARGET_CONFIG
	string "Use an alternate subtarget kernel config"
	depends on TARGET_intel_x86
	help
	  Use an alternate subtarget kernel config other than config-default like config-default-x.
	  Mention only the file suffix name 'x' here.

config INTEL_X86_KERNEL_METADATA
        bool "UGW KERNEL METADATA FRAMEWORK"
        depends on (TARGET_intel_x86_lgm)
        help
          Used for enabling the metadata framework on the kernel.

config BUILD_SDK
	string "Type/Name of the SDK"
	depends on TARGET_intel_x86
	default "ugw"
	help
	  Specify the Type/Name of SDK being used.
	  Mention one of 'ugw' or 'prplos' here

config INTEL_X86_ENV_SZ
	hex 'config env size'
	depends on TARGET_intel_x86
	default 0x80000
	help
	  config u-boot env partition size 

menuconfig INTEL_X86_SECBOOT
	bool "Secure Boot Image options for X86 based Intel Platforms" if IMAGEOPT
	depends on (TARGET_intel_x86_lgm)
	help
			These options allow to build secure boot image variant for
			Intel X86 Platform. Input signtool, public key and
			CRkey (Confidentiality Root Key) with optional Certificate
			support and path

config OSP_TB341_v1_PON_OVERLAY
	bool "OSP-v1 PON DTS changes for single image"
	help
		OSP-v1 PON DTS changes for single image.

config WAVE_700
	bool "Enables the BM Policy for WAVE_700"
	help
		Enables the BM Policy for WAVE_700.

config WAVE_6X4
	bool "Enables the BM Policy for WAVE_6X4"
	help
		Enables the BM Policy for WAVE_6X4.

if INTEL_X86_SECBOOT
	config INTEL_X86_EXTERNAL_IMAGE_SIGNING
		bool "enable external image signing"
		help
			Build system generates unsigned images.External
			signing util will be used to sign these images.
	
	config INTEL_X86_SIGNING_SER_USER
		string "signing server user"
		default ""
		help
			external signing server user.
	
	config INTEL_X86_SIGNING_SER_PASS
		string "signing server password"
		default ""
		help
			external signing server password.

	config INTEL_X86_KEYS_PROVISION
		bool "provison of keys done"
		help
			keys path properly set

	config INTEL_X86_SIGNTOOL
		string "signtool (path)"
		default "signtool"
		help
			signtool as released to Customer
			If unspecified, it defaults to signtool.

	config INTEL_X86_PROD_UNIQUE_KEY
		string "product unique key(path)"
		default "CRkey.bin"
		help
			AES256 product unique key.
			If unspecified, it defaults to CRkey.bin

	config INTEL_X86_PRIVATE_KEY
		string "private key(path)"
		default "privatekey.der"
		help
			ECDSA256 private key.
			If unspecified, it defaults to privatekey.der

	config INTEL_X86_ENC_KEY
		string "enc key(path)"
		default "ENCkey.bin"
		help
			ENC256 private key.
			If unspecified, it defaults to ENCkey.bin

	config INTEL_X86_CERTIFICATION_SUPPORT
		bool "Certification Support"
		help
			enable chain of trust certificate.

	config INTEL_X86_CERTIFICATION
		string "certification(path)"
		default "cert.bin"
		depends on INTEL_X86_CERTIFICATION_SUPPORT
		help
			ECDSA256 certificate
			If unspecified, it defaults to cert.bin

	config INTEL_X86_TEP_BASEADDR
		hex 'tep base address'
		default 0x00100000
		help
			tep base address

	config INTEL_X86_AIC_BASEADDR
		hex 'aic base address'
		default 0x010000000
		help
			aic base address

	config INTEL_X86_KERNEL_BASEADDR
		hex 'kernel base address'
		default 0x8200000
		help
			kernel base address

	config INTEL_X86_KERNEL_ROLLBACKID
		hex 'kernel roll back id'
		default 0x1
		help
			kernel roll back id

	config INTEL_X86_ROOTFS_ROLLBACKID
		hex 'rootfs roll back id'
		default 0x1
		help
			rootfs roll back id

	config INTEL_X86_DTB_ROLLBACKID
		hex 'dtb roll back id'
		default 0x1
		help
			device tree roll back id

	config INTEL_X86_TEP_ROLLBACKID
		hex 'tep roll back id'
		default 0x1
		help
			tep roll back id

	config INTEL_X86_KERNEL_FLEXI_ROLLBACKID
		hex 'kernel flexi roll back id'
		default 0x1
		help
			kernel flexi roll back id

	config INTEL_X86_ROOTFS_FLEXI_ROLLBACKID
		hex 'rootfs flexi roll back id'
		default 0x1
		help
			rootfs flexi roll back id

endif
```

## intel_x86/image/fullimage-fit.its
```
/*
 * The image source file creates FIT image with MXL URX Linux kernel Device Tree FIT and rootfs FIT
 */

/dts-v1/;

/ {
	description = "FIT image with MXL URX Linux kernel-DTB FIT and rootfs FIT image";

	images {
		kernel-dtb {
			description = "MXL URX Linux kernel and DTB FIT Image";
			data = /incbin/("KERNEL-DTB");
			type = "firmware";
			arch = "x86_64";
			os = "linux";
			compression = "none";
		};
		filesystem {
			description = "MXL URX Rootfs FIT image";
			data = /incbin/("ROOTFS");
			type = "firmware";
			arch = "x86_64";
			compression = "none";
		};
	};

	configurations {
		default = "kernel-dtb-rootfs-conf";
		kernel-dtb-rootfs-conf {
			description = "MXL URX Linux kernel + DBT + rootfs";
			kernel = "kernel-dtb";
			filesystem = "filesystem";
		};
	};
};
```

## intel_x86/image/totalimage-fit-sdl.its
```
/*
 * The image source file creates FIT image with MXL URX Linux kernel Device Tree FIT and rootfs FIT
 */

/dts-v1/;

/ {
	description = "FIT image with MXL URX RBE, u-boot FIT, TEP FIT, Linux kernel-DTB FIT and rootfs FIT";

	images {
		rbe {
			description = "MXL URX RBE Image";
			data = /incbin/("u-boot-spl-emmc.bin");
			type = "firmware";
			arch = "x86_64";
			compression = "none";
		};
		uboot {
			description = "MXL URX UBOOT FIT Image";
			data = /incbin/("u-boot.itb");
			type = "firmware";
			arch = "x86_64";
			compression = "none";
		};
		tep {
			description = "MXL URX TEP FIT image";
			data = /incbin/("tep_fw.itb");
			type = "firmware";
			arch = "x86_64";
			compression = "none";
		};
		kernel-dtb {
			description = "MXL URX Linux kernel and DTB FIT Image";
			data = /incbin/("prplos-intel_x86-lgm-PRPL_MB_URX-641_wav700-kernel.itb");
			type = "firmware";
			arch = "x86_64";
			os = "linux";
			compression = "none";
		};
		filesystem {
			description = "MXL URX Rootfs FIT image";
			data = /incbin/("prplos-intel_x86-lgm-PRPL_MB_URX-rootfs.itb");
			type = "firmware";
			arch = "x86_64";
			compression = "none";
		};
	};

	configurations {
		default = "rbe-uboot-tep-kernel-dtb-rootfs-conf";
		rbe-uboot-tep-kernel-dtb-rootfs-conf {
			description = "MXL URX RBE + Ubooot + tep + Linux kernel + DBT + rootfs";
			rbe = "rbe";
			uboot = "uboot";
			tep = "tep";
			kernel = "kernel-dtb";
			filesystem = "filesystem";
		};
	};
};
```

## intel_x86/image/update_script.its
```
/dts-v1/;

/ {
	description = "FIT Image containing the upgrade script";

	images {
		update-script {
			description = "Update script";
			data = /incbin/("update_script.txt");
			type = "script";
			arch = "x86_64";
			os = "u-boot";
			compression = "none";
		};
	};
};
```
